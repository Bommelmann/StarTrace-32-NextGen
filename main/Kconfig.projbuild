## main/Kconfig.projbuild
```kconfig
menu "Startrace Custom Configuration"

    menu "DIAG Wifi Config"
            comment "DIAG WIFI Configuration"
    
            config ESP_WIFI_AP_SSID
                string "DIAG WIFI SSID"
                default "myssid"
                help
                    SSID (network name) of the AP for the example to connect to.
    
            config ESP_WIFI_AP_PASSWORD
                string "DIAG WIFI Password"
                default "mypassword"
                help
                    WiFi password of the AP for the example to use.
    
            config ESP_WIFI_AP_CHANNEL
                int "DIAG WIFI Channel"
                range 1 14
                default 1
                help
                    WiFi channel (network channel) of the AP for the example to use.
    
            config ESP_MAX_STA_CONN_AP
                int "DIAG WIFI connections"
                default 1
                help
                    Max number of the STA connects to AP.  
    endmenu

    
    menu "External WIFI Configuration"
        comment "External WIFI Configuration"

        config ESP_MAXIMUM_STA_RETRY
            int "Maximum retry"
            default 5
            help
                Set the maximum retry value to prevent the station from continuously
                attempting to reconnect to the Access Point (AP) when the AP doesn't exist.

        choice ESP_WIFI_SCAN_AUTH_MODE_THRESHOLD
            prompt "WiFi Scan auth mode threshold"
            default ESP_WIFI_AUTH_OPEN
            help
                The weakest authmode to accept in the scan mode.
                This value defaults to ESP_WIFI_AUTH_WPA2_PSK incase password is present
                and ESP_WIFI_AUTH_OPEN is used. Please select ESP_WIFI_AUTH_WEP / ESP_WIFI_AUTH_WPA_PSK
                incase AP is operating in WEP / WPA mode.

            config ESP_WIFI_AUTH_OPEN
                bool "OPEN"
            config ESP_WIFI_AUTH_WEP
                bool "WEP"
            config ESP_WIFI_AUTH_WPA_PSK
                bool "WPA PSK"
            config ESP_WIFI_AUTH_WPA2_PSK
                bool "WPA2 PSK"
            config ESP_WIFI_AUTH_WPA_WPA2_PSK
                bool "WPA/WPA2 PSK"
            config ESP_WIFI_AUTH_WPA3_PSK
                bool "WPA3 PSK"
            config ESP_WIFI_AUTH_WPA2_WPA3_PSK
                bool "WPA2/WPA3 PSK"
            config ESP_WIFI_AUTH_WAPI_PSK
                bool "WAPI PSK"
        endchoice

    endmenu

    menu "SD Config"

    config EXAMPLE_PIN_MOSI
        int "MOSI GPIO number"
        default 11

    config EXAMPLE_PIN_MISO
        int "MISO GPIO number"
        default 13

    config EXAMPLE_PIN_CLK
        int "CLK GPIO number"
        default 12

    config EXAMPLE_PIN_CS
        int "CS GPIO number"
        default 10
    endmenu

    menu "UDS Config"

        config P2_CLIENT
        int "P2 Client"
        default 2000
        help
            This option defines the timeout for a client to wait for a response from the server.
    endmenu

endmenu
```
